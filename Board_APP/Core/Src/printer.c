/*==============================================================================

Filename: printer.c

Created on: Jan 27, 2023

Original work: Copyright (c) 2023 Luca Favenzi
Modified work:

Permission is hereby granted, free of charge, to any person obtaining a copy
of this software and associated documentation files (the "Software"), to deal
in the Software without restriction, including without limitation the rights
to use, copy, modify, merge, publish, distribute, sublicense, and/or sell
copies of the Software, and to permit persons to whom the Software is
furnished to do so, subject to the following conditions:

The above copyright notice and this permission notice shall be included in all
copies or substantial portions of the Software.

THE SOFTWARE IS PROVIDED "AS IS", WITHOUT WARRANTY OF ANY KIND, EXPRESS OR
IMPLIED, INCLUDING BUT NOT LIMITED TO THE WARRANTIES OF MERCHANTABILITY,
FITNESS FOR A PARTICULAR PURPOSE AND NONINFRINGEMENT. IN NO EVENT SHALL THE
AUTHORS OR COPYRIGHT HOLDERS BE LIABLE FOR ANY CLAIM, DAMAGES OR OTHER
LIABILITY, WHETHER IN AN ACTION OF CONTRACT, TORT OR OTHERWISE, ARISING FROM,
OUT OF OR IN CONNECTION WITH THE SOFTWARE OR THE USE OR OTHER DEALINGS IN THE
SOFTWARE.

Visit www.favenzi.it
      luca@favenzi.it

================================================================================
PURPOSE:
USAGE:
==============================================================================*/

#include <string.h>
#include <stdio.h>
#include <stdarg.h>

#include "printer.h"

#include "time.h"
#include "globals.h"
#include "settings.h"
#include "stm32f1xx_hal.h"
#include "sensors.h"
#include "modes.h"
#include "usbkey.h"
#include "system.h"

#define DC2 0x12
#define ESC	0x1B
#define FS	0x1C
#define GS  0x1D

extern UART_HandleTypeDef UART_PRINTER;
extern Settings_s settings;
extern MachineData_s machine;
void PrintSend(const char* format, ...);

unsigned char reverse_byte(unsigned char x);

const unsigned char logo[] = {
		0x00, 0x00, 0x00, 0x00, 0x00, 0x00, 0x00, 0x00, 0x00, 0x00, 0x00, 0x00, 0x00, 0x00, 0x00, 0x00,
		0x00, 0x00, 0x00, 0x00, 0x00, 0x00, 0x00, 0x00, 0x00, 0x00, 0x00, 0x00, 0x00, 0x00, 0x00, 0x00,
		0x00, 0x00, 0x00, 0x00, 0x00, 0x00, 0x00, 0x00, 0x00, 0x00, 0x00, 0x00, 0x00, 0x00, 0x00, 0x00,
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		0x00, 0x00, 0x00,};

void PrinterInit() {
	char d[10];

	PrintSend("%c%c", ESC, '@'); // Reset
//	Print("%c%c", ESC, '5'); // Charset 2
//	Print("%c%c", FS, '.'); // Disable Chinese Print Mode
//	Print("%c%c", ESC, 0x54); // Upside-down print
//	Print("%c%c%c", ESC, 0x57, 1); // Font size
	PrintSend("%c%c%c", ESC, '!', 0b00000101);
//	Print("%c%c%c", ESC, '3', 10); // Line spacing (n*0.125mm, def. 30)
//	Print("%c%c%c", ESC, 'a', 0); // Justify (0 = left, 1 = center, 2 = right)
//	Print("%c%c%c",  GS, '!', 0x00);
//	Print("%c%c%c",  FS, '.', 2);
//	Print("%c%c%c",  ESC, 't', 2);
//	Print("%c%c%c%c%c%c%c%c%c", ESC, '&', 64, 0, 96, 144, 144, 96, 0);
}

void PrintSize(uint8_t width, uint8_t height) {
	PrintSend("%c%c%c", ESC, 'U', width); // Font width
//	Print("%c%c%c", ESC, 'W', size); // Font size
	PrintSend("%c%c%c", ESC, 'V', height); // Font height
}

//void Print(const char* data) {
//	HAL_UART_Transmit(&huart4, data, strlen(data), 1000);
//}

void PrintTestPage() {
	PrintSend("%c%c", DC2, 'T'); // Reset
}

void PrintError(const char* errorString, RTCTimerTime_s* tTime) {
	Print(errorString);
	Print("----    T1     T2    kPa    TIME\n");
	Print("      %5.1f  %5.1f  %5.1f %3d:%02d\n", sensors.T1, sensors.T2, GetNormalizedPressure(sensors.PressureChamber), tTime->TimeMinute, tTime->TimeSecond);
	Print("        T3     T4    TDS   DO  LO\n");
	Print("      %5.1f  %5.1f %5d   %s  %s\n", 	sensors.TemperatureChamberHeater,
												sensors.TemperatureSteamGenerator,
												sensors.WaterTDS,
												(sensors.Door == OPEN) ? "OP" : "CL",
												(sensors.Solenoid == LOCK) ? "LK" : "UN"
												);
	Print("\n");
	Print("\n");
	Print("\n");
	Print("\n");
}

void PrintSend(const char* format, ...) {

		  va_list args;
		  char* buf[80];
		  va_start(args, format);
		  vsprintf(buf, format, args);
		  //printf(buf);
		  va_end(args);

		  if (settings.FunPrinterActive == 1) {
			  HAL_UART_Transmit(&UART_PRINTER, buf, strlen(buf), 1000);
	//		  HAL_UART_Transmit(&huart1, "\n", 1, 100);
		  }

}

void Print(const char* format, ...) {

		  va_list args;
		  char* buf[80];
		  va_start(args, format);
		  vsprintf(buf, format, args);
		  //printf(buf);
		  va_end(args);

		  if (settings.FunPrinterActive == 1) {
			  HAL_UART_Transmit(&UART_PRINTER, buf, strlen(buf), 1000);
	//		  HAL_UART_Transmit(&huart1, "\n", 1, 100);
		  }
		  if (settings.FunUSBActive == 1) {
//			  SdcardWriteAction(currFilename , buf);
			  xQueueSend(usbQueue, buf, 100);
		  }

}

void PrintLogo() {
////	uint8_t logo[] = {0x7C, 0x44, 0x44, 0xFF, 0x44, 0x44, 0x7C, 0x00, 0x41, 0x62, 0x54, 0xC8, 0x54, 0x62, 0x41};
//uint8_t w = 200;
//uint8_t h = 91;
//
//	uint8_t data[w];
//	uint8_t end[1] = {13};
//
//	uint8_t cmd[4] = {ESC, 'K', (w % 256), (w / 256)};
//
//	int c = 0;
//	for (int y = 0; y < (h / 8); y++) {
//		for (int x = 0; x < w; x++) {
//			data[x] = reverse_byte(logo[c]);
//			c++;
//		}
//		HAL_UART_Transmit(&UART_PRINTER, cmd, sizeof(cmd), 500);
//		HAL_UART_Transmit(&UART_PRINTER, data, sizeof(data), 500);
//		HAL_UART_Transmit(&UART_PRINTER, end, sizeof(end), 500);
//	}
}

void PrintHeader (const char* title, float t1, RTCDateTime_s* time) {

	Print("\n");
	Print("******************************************\n");
//	Print("123456789012345678901234567890123456789012\n");
	PrintSize(2, 2);
//	Print("%c%c%c", ESC, 'a', 1); // Justify (0 = left, 1 = center, 2 = right)
	Print("%s\n", title);
//	Print("%c%c%c", ESC, 'a', 0); // Justify (0 = left, 1 = center, 2 = right)
	PrintSize(1, 1);
	if (currProgType == PROGTYPE_PROGRAM) {
		uint8_t vacN;
		if (currProgram == PROGRAM_UNWRAPPED) vacN = 1;
		else if (currProgram == PROGRAM_USER) vacN = settings.UserVacuumNumber;
		else vacN = settings.VacNumber;
		if (currProgram == PROGRAM_USER) {
				uint8_t tSter = (settings.UserSterilTemp == STERILTEMP_134) ? 134 : 121;
				uint8_t minSter = settings.UserSterilTime;
				uint8_t secSter = 0;
				uint8_t minDry = settings.UserDryTime;
				uint8_t secDry = 0;
				uint16_t press = (settings.UserSterilTemp == STERILTEMP_134) ? 310 : 220;
				press = (settings.FunPressureDisplay == 1) ? press : (press - 100);
				Print("VAC.N.  Temp.   Press.   Time   Dry\n");
				//       3     134'C   310kPa  10:34  10:34
				Print(" %2d     %3d'C   %3dkPa  %2d:%02d  %2d:%02d", vacN, tSter, press, minSter, secSter, minDry, secDry);
				Print("\n");
			} else {
				uint8_t tSter = (programs[currProgram].SterilTemp == STERILTEMP_134) ? 134 : 121;
				uint8_t minSter = programs[currProgram].SterilTime / 60;
				uint8_t secSter = programs[currProgram].SterilTime % 60;
				uint8_t minDry = programs[currProgram].DryTime / 60;
				uint8_t secDry = programs[currProgram].DryTime % 60;
				Print("VAC.N.  Temp.   Press.   Time   Dry\n");
				//       3     134'C   310kPa  10:34  10:34
				Print(" %2d     %3d'C   %3dkPa  %2d:%02d  %2d:%02d", vacN, tSter, (uint16_t)GetNormalizedPressure(programs[currProgram].SterilPress), minSter, secSter, minDry, secDry);
				Print("\n");
			}
	} else if (currProgType == PROGTYPE_TEST) {
		uint8_t vacN;
		if (currTest == TEST_VACUUM) vacN = 1;
		else if (currTest == TEST_HELIX) vacN = 3;
		else if (currTest == TEST_WASH) vacN = 0;
		else vacN = settings.VacNumber;
		if (currTest == TEST_VACUUM) {
			uint8_t minSter = 210 / 60;
			uint8_t secSter = 210 % 60;
			uint8_t minDry = 300 / 60;
			uint8_t secDry = 300 % 60;
			Print("VAC.N.  Temp.   Press.   Time   Dry\n");
			//       3     134'C   310kPa  10:34  10:34
			Print(" %2d     %3d'C   %3dkPa  %2d:%02d  %2d:%02d", vacN, 134, (settings.FunPressureDisplay == 1) ? 310 : 210, minSter, secSter, minDry, secDry);
			Print("\n");
		}
	}
	Print("------------------------------------------\n");
	Print("\n");
	Print("S/N:          %s\n", machine.Serial);
	Print("UID:          %08X %08X %08X\n", machine.MCUID[2], machine.MCUID[1], machine.MCUID[0]);
	Print("Firmware:     v.%d.%02d.%1d (%d.%02d.%1d)\n", machine.FWVersionMajor, machine.FWVersionMinor, machine.FWVersionRevision, machine.DisplayFWVersionMajor, machine.DisplayFWVersionMinor, machine.DisplayFWVersionRevision);
	Print("\n");
	Print("Date (Y-M-D): %d-%02d-%02d\n", time->Year, time->Month, time->Day);
	Print("CYCLE N.      %d\n", settings.CyclesCount);
	Print("\n");
	Print("ATM (kPa)     %0.1f\n", sensors.PressureAmbient);
	Print("\n");
	Print("\n");
	Print("USER:\n");
	Print("\n");
	Print("------------------------------------------\n");
	Print("STEP    T1     T2   PRESS   TIME\n");
	Print("        'C     'C    kPa   mm:ss\n");
	Print("------------------------------------------\n");
	Print("START %5.1f             %02d:%02d:%02d\n", t1, time->Hour, time->Minute, time->Second);
}

void PrintFooter (const char* result, RTCDateTime_s* time, RTCTimerTime_s* timer) {
	Print("FINISH                  %02d:%02d:%02d\n", time->Hour, time->Minute, time->Second);
	Print("------------------------------------------\n");
	Print("TOTAL TIME                 %2d:%02d\n", timer->TimeMinute, timer->TimeSecond);
	Print("\n");
	PrintSize(3, 2);
	if (lastError == 0)	Print("%s\n", result);
	else Print("%s Err.%0d\n", result, lastError);
	PrintSize(1, 1);
	Print("\n");
	if (lastError != 0) PrintError("", time);
	Print("\n");
	Print("\n");
	Print("INDICATOR STRIP: PASS [] FAIL []\n");
	Print("\n");
	Print("\n");
	Print("OPERATOR: ________________________________\n");
	Print("\n");
	Print("******************************************\n");
	Print("\n");
	Print("\n");
	Print("\n");
	Print("\n");
}

void PrintStepLine(const char* step, float t1, float t2, float pressure, RTCTimerTime_s* time) {
	Print("%.4s  %5.1f  %5.1f  %5.1f %3d:%02d\n", step, t1, t2, GetNormalizedPressure(pressure), time->TimeMinute, time->TimeSecond);
}

void PrintDivisor() {
	char* s = "******************************************\n";
	Print(s);
}

void PrintLF(uint8_t lines) {
	char data[lines + 1];
	for (int i = 0; i < lines; i++) {
		data[i] = 0x1b;
	}
	data[lines] = 0x0;
	Print(data);
}

unsigned char reverse_byte(unsigned char x) {
    static const unsigned char table[] = {
        0x00, 0x80, 0x40, 0xc0, 0x20, 0xa0, 0x60, 0xe0,
        0x10, 0x90, 0x50, 0xd0, 0x30, 0xb0, 0x70, 0xf0,
        0x08, 0x88, 0x48, 0xc8, 0x28, 0xa8, 0x68, 0xe8,
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        0x1f, 0x9f, 0x5f, 0xdf, 0x3f, 0xbf, 0x7f, 0xff,
    };
    return table[x];
}
